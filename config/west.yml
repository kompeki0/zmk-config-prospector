## config/west.yml
```yaml
manifest:
  remotes:
    - name: zmkfirmware
      url-base: https://github.com/zmkfirmware
    - name: prospector
      url-base: https://github.com/t-ogura
    - name: kompeki0
      url-base: https://github.com/kompeki0
  projects:
    - name: zmk
      remote: zmkfirmware
      revision: main
      import: app/west.yml
    - name: prospector-zmk-module
      remote: prospector
      revision: v2.1.0
      path: modules/prospector-zmk-module
    - name: zmk-converter
      remote: kompeki0
      revision: main
  self:
    path: config
```
